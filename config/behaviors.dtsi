/ {
  behaviors {
    to_1_hold_fslh: to_1_hold_fslh {
      compatible = "zmk,behavior-hold-tap";
      #binding-cells = <0>;
      tapping-term-ms = <200>;
      flavor = "tap-preferred";
      bindings = <&to 1 &kp FSLH>;
    };
  };
};
