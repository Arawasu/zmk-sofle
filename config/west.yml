## config/west.yml
```yaml
manifest:
  remotes:
    - name: zmkfirmware
      url-base: https://github.com/zmkfirmware

    - name: gpeye
      url-base: https://github.com/GPeye

    # left-side widgets
    - name: mctechnology17
      url-base: https://github.com/mctechnology17
  projects:
    - name: eyelash_sofle
      url: https://github.com/Arawasu/zmk-sofle
      revision: main

    - name: hammerbeam-slideshow
      remote: gpeye
      revision: main

    - name: zmk
      remote: zmkfirmware
      revision: main
      import: app/west.yml

    - name: zmk-nice-oled
      remote: mctechnology17
      revision: main

  self:
    path: config
```
